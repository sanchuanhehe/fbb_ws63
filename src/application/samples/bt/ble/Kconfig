## src/application/samples/bt/ble/Kconfig
```kconfig
#===============================================================================
# @brief    Kconfig file.
# Copyright (c) HiSilicon (Shanghai) Technologies Co., Ltd. 2023-2023. All rights reserved.
#===============================================================================

choice
    prompt "BLE Sample"

config SAMPLE_SUPPORT_BLE_SPEED_SERVER_SAMPLE
    bool "Support BLE Throughput Server Sample."

if SAMPLE_SUPPORT_BLE_SPEED_SERVER_SAMPLE
osource "application/samples/bt/ble/ble_speed_server/Kconfig"
endif

config SAMPLE_SUPPORT_BLE_SPEED_CLIENT_SAMPLE
    bool "Support BLE Throughput Client Sample"

config SAMPLE_SUPPORT_BLE_CFG_SAMPLE
    bool "Support BLE WIFI CFG Sample"

endchoice
```

## src/application/samples/bt/ble/ble_speed_server/Kconfig
```kconfig
#===============================================================================
# @brief    Kconfig file.
# Copyright (c) HiSilicon (Shanghai) Technologies Co., Ltd. 2023-2023. All rights reserved.
#===============================================================================

config BLE_SPEED_TEST
    bool
    prompt "Set the sample support speed test"
    default y
    help
        This option means whether the sample support speed test.
```

## src/application/samples/peripheral/pwm/Kconfig
```kconfig
#===============================================================================
# @brief    Kconfig file.
# Copyright (c) HiSilicon (Shanghai) Technologies Co., Ltd. 2023-2023. All rights reserved.
#===============================================================================
config PWM_CHANNEL
    int
    prompt "Choose PWM Test Channel."
    depends on SAMPLE_SUPPORT_PWM
    default 4

config PWM_GROUP_ID
    int
    prompt "Choose PWM Test Group ID."
    depends on SAMPLE_SUPPORT_PWM && PWM_USING_V151
    default 0

config PWM_PIN
    int
    prompt "Choose PWM pin."
    depends on SAMPLE_SUPPORT_PWM
    default 12

config PWM_PIN_MODE
    int
    prompt "Choose PWM pin mode."
    default 1
    depends on SAMPLE_SUPPORT_PWM
```

## vendor/DyCloud_WF6301_DK V1.0/demo/at24c02/Kconfig
```kconfig
#===============================================================================
# @brief    Kconfig file.
# Copyright (c) HiSilicon (Shanghai) Technologies Co., Ltd. 2023-2023. All rights reserved.
#===============================================================================

config I2C_AT24C02_BUS_ID
    int
    prompt "Choose I2C AT24C64 bus id."
    depends on SAMPLE_SUPPORT_AT24C02
    default 1

config I2C_SCL_AT24C02_PIN
    int
    prompt "Choose I2C SCL AT24C64 pin."
    depends on SAMPLE_SUPPORT_AT24C02
    default 16

config I2C_SDA_AT24C02_PIN
    int
    prompt "Choose I2C SDA AT24C64 pin."
    depends on SAMPLE_SUPPORT_AT24C02
    default 15

config I2C_AT24C02_PIN_MODE
    int
    prompt "Choose I2C AT24C64 pin mode."
    depends on SAMPLE_SUPPORT_AT24C02
    default 2

config I2C_AT24C02_ADDR
    hex
    prompt "Choose I2C AT24C64 slave addr."
    depends on SAMPLE_SUPPORT_AT24C02
    default 0x50
```

## vendor/DyCloud_WF6301_DK V1.0/demo/cht20/Kconfig
```kconfig
#===============================================================================
# @brief    Kconfig file.
# Copyright (c) HiSilicon (Shanghai) Technologies Co., Ltd. 2023-2023. All rights reserved.
#===============================================================================

config I2C_CHT20_BUS_ID
    int
    prompt "Choose I2C CHT20 bus id."
    depends on SAMPLE_SUPPORT_CHT20
    default 1

config I2C_SCL_CHT20_PIN
    int
    prompt "Choose I2C SCL CHT20 pin."
    depends on SAMPLE_SUPPORT_CHT20
    default 16

config I2C_SDA_CHT20_PIN
    int
    prompt "Choose I2C SDA CHT20 pin."
    depends on SAMPLE_SUPPORT_CHT20
    default 15

config I2C_CHT20_PIN_MODE
    int
    prompt "Choose I2C CHT20 pin mode."
    depends on SAMPLE_SUPPORT_CHT20
    default 2

config I2C_CHT20_SLAVE_ADDR
    hex
    prompt "Choose I2C CHT20 slave addr."
    depends on SAMPLE_SUPPORT_CHT20
    default 0x38
```

## vendor/DyCloud_WF6301_DK V1.0/demo/sc7a20/Kconfig
```kconfig
#===============================================================================
# @brief    Kconfig file.
# Copyright (c) HiSilicon (Shanghai) Technologies Co., Ltd. 2023-2023. All rights reserved.
#===============================================================================


config I2C_SC7A20_BUS_ID
    int
    prompt "Choose I2C master bus id."
    depends on SAMPLE_SUPPORT_SC7A20
    default 1

config I2C_SCL_SC7A20_PIN
    int
    prompt "Choose I2C SCL master pin."
    depends on SAMPLE_SUPPORT_SC7A20
    default 16

config I2C_SDA_SC7A20_PIN
    int
    prompt "Choose I2C SDA master pin."
    depends on SAMPLE_SUPPORT_SC7A20
    default 15

config I2C_SC7A20_PIN_MODE
    int
    prompt "Choose I2C master pin mode."
    depends on SAMPLE_SUPPORT_SC7A20
    default 2

config I2C_SC7A20_SLAVE_ADDR
    hex
    prompt "Choose I2C slave addr."
    depends on SAMPLE_SUPPORT_SC7A20
    default 0x19
```

## vendor/DyCloud_WF6301_DK V1.0/demo/ws2812b/Kconfig
```kconfig
#===============================================================================
# @brief    Kconfig file.
# Copyright (c) HiSilicon (Shanghai) Technologies Co., Ltd. 2023-2023. All rights reserved.
#===============================================================================
config WS2812B_CHANNEL
    int
    prompt "Choose WS2812B Test Channel."
    depends on SAMPLE_SUPPORT_WS2812B
    default 3

config WS2812B_GROUP_ID
    int
    prompt "Choose WS2812B Test Group ID."
    depends on SAMPLE_SUPPORT_WS2812B && PWM_USING_V151
    default 0

config WS2812B_PIN
    int
    prompt "Choose WS2812B pin."
    depends on SAMPLE_SUPPORT_WS2812B
    default 3

config WS2812B_PIN_MODE
    int
    prompt "Choose WS2812B pin mode."
    default 1
    depends on SAMPLE_SUPPORT_WS2812B
```

## vendor/DyCloud_WF6301_DK_V1.0/demo/breathing_light/Kconfig
```kconfig
#===============================================================================
# @brief    Kconfig file.
# Copyright (c) HiSilicon (Shanghai) Technologies Co., Ltd. 2023-2023. All rights reserved.
#===============================================================================
config BREATHING_LIGHT_CHANNEL
    int
    prompt "Choose BREATHING_LIGHT Test Channel."
    depends on SAMPLE_SUPPORT_BREATHING_LIGHT
    default 3

config BREATHING_LIGHT_GROUP_ID
    int
    prompt "Choose BREATHING_LIGHT Test Group ID."
    depends on SAMPLE_SUPPORT_BREATHING_LIGHT && PWM_USING_V151
    default 0

config BREATHING_LIGHT_PIN
    int
    prompt "Choose BREATHING_LIGHT pin."
    depends on SAMPLE_SUPPORT_BREATHING_LIGHT
    default 3

config BREATHING_LIGHT_PIN_MODE
    int
    prompt "Choose BREATHING_LIGHT pin mode."
    default 1
    depends on SAMPLE_SUPPORT_BREATHING_LIGHT
```

## vendor/DyCloud_WF6301_DK_V1.0/demo/lcd/Kconfig
```kconfig
config LCD_DATA
    int
    prompt "Choose LCD DEVICE SPI DATA pin."
    depends on SAMPLE_SUPPORT_LCD
    default 9

config LCD_CLK
    int
    prompt "Choose LCD DEVICE SPI CLK pin."
    depends on SAMPLE_SUPPORT_LCD
    default 7

config LCD_CS
    int
    prompt "Choose LCD DEVICE CS pin."
    depends on SAMPLE_SUPPORT_LCD
    default 10

config LCD_RST
    int
    prompt "Choose LCD DEVICE RST pin."
    depends on SAMPLE_SUPPORT_LCD
    default 8

config LCD_RS
    int
    prompt "Choose LCD DEVICE RS pin."
    depends on SAMPLE_SUPPORT_LCD
    default 11

config SPI_MASTER_BUS_ID
    int
    prompt "Choose SPI_MASTER_BUS_ID."
    depends on SAMPLE_SUPPORT_LCD
    default 0
```

## vendor/HiHope_NearLink_DK_WS63E_V03/demo/sle_one_to_many/Kconfig
```kconfig
config SAMPLE_SUPPORT_SLE_SERVER_MANY
    bool
    prompt "Support SLE_SERVER_MANY Sample."
    default n
    depends on SAMPLE_SUPPORT_SLE_ONE_TO_MANY
    help
        This option means support SLE_SERVER_MANY Sample.

config SAMPLE_SUPPORT_SLE_CLIENT_ONE
    bool
    prompt "Support SLE_CLIENT_ONE  Sample."
    default n
    depends on SAMPLE_SUPPORT_SLE_ONE_TO_MANY
    help
        This option means support SLE_CLIENT_ONE Sample.
```

## vendor/HiHope_NearLink_DK_WS63E_V03/demo/sle_throughput/Kconfig
```kconfig
#===============================================================================
# @brief    Kconfig file.
# Copyright (c) @CompanyNameMagicTag 2023-2023. All rights reserved.
#===============================================================================
config SAMPLE_SUPPORT_SLE_SERVER_SPEED
    bool
    prompt "Support SLE_SERVER_SPEED Sample."
    default n
    depends on SAMPLE_SUPPORT_SLE_THROUGHPUT
    help
        This option means support SLE_SERVER_SPEED Sample.

config LARGE_THROUGHPUT_SERVER
    bool "server large throughput."
    default y
    depends on SAMPLE_SUPPORT_SLE_SERVER_SPEED

config SAMPLE_SUPPORT_SLE_CLIENT_SPEED
    bool
    prompt "Support SLE_CLIENT_SPEED  Sample."
    default n
    depends on SAMPLE_SUPPORT_SLE_THROUGHPUT
    help
        This option means support SLE_CLIENT_SPEED Sample.

config LARGE_THROUGHPUT_CLIENT
    bool "client large throughput."
    default y
    depends on SAMPLE_SUPPORT_SLE_CLIENT_SPEED
```

## vendor/Hqyj_Ws63/Farsight/Kconfig
```kconfig
config SAMPLE_SUPPORT_KERNEL_01_TASK
    bool
    prompt "Support KERNEL_01_TASK Sample."
    default n
    depends on ENABLE_FARSIGHT_SAMPLE
    help
        This option means support KERNEL_01_TASK Sample.

config SAMPLE_SUPPORT_KERNEL_02_TIMER
    bool
    prompt "Support KERNEL_02_TIMER Sample."
    default n
    depends on ENABLE_FARSIGHT_SAMPLE
    help
        This option means support KERNEL_02_TIMER Sample.

config SAMPLE_SUPPORT_KERNEL_03_EVENT
    bool
    prompt "Support KERNEL_03_EVENT Sample."
    default n
    depends on ENABLE_FARSIGHT_SAMPLE
    help
        This option means support KERNEL_03_EVENT Sample.

config SAMPLE_SUPPORT_KERNEL_04_MUTEX
    bool
    prompt "Support KERNEL_04_MUTEX Sample."
    default n
    depends on ENABLE_FARSIGHT_SAMPLE
    help
        This option means support KERNEL_04_MUTEX Sample.

config SAMPLE_SUPPORT_KERNEL_05_MUTEX_SEMAPHORE
    bool
    prompt "Support KERNEL_05_MUTEX_SEMAPHORE Sample."
    default n
    depends on ENABLE_FARSIGHT_SAMPLE
    help
        This option means support KERNEL_05_MUTEX_SEMAPHORE Sample.

config SAMPLE_SUPPORT_KERNEL_06_SYNC_SEMAPHORE
    bool
    prompt "Support KERNEL_06_SYNC_SEMAPHORE Sample."
    default n
    depends on ENABLE_FARSIGHT_SAMPLE
    help
        This option means support KERNEL_06_SYNC_SEMAPHORE Sample.

config SAMPLE_SUPPORT_KERNEL_07_COUNT_SEMAPHORE
    bool
    prompt "Support KERNEL_07_COUNT_SEMAPHORE Sample."
    default n
    depends on ENABLE_FARSIGHT_SAMPLE
    help
        This option means support KERNEL_07_COUNT_SEMAPHORE Sample.

config SAMPLE_SUPPORT_KERNEL_08_MESSGE_QUEQUE
    bool
    prompt "Support KERNEL_08_MESSGE_QUEQUE Sample."
    default n
    depends on ENABLE_FARSIGHT_SAMPLE
    help
        This option means support KERNEL_08_MESSGE_QUEQUE Sample.

config SAMPLE_SUPPORT_LEDBLINK
    bool
    prompt "Support LEDBLINK Sample."
    default n
    depends on ENABLE_FARSIGHT_SAMPLE
    help
        This option means support LEDBLINK Sample.

config SAMPLE_SUPPORT_UART
    bool
    prompt "Support UART Sample."
    default n
    depends on ENABLE_FARSIGHT_SAMPLE
    help
        This option means support UART Sample.
        
config SAMPLE_SUPPORT_OLED_SSD1306
    bool
    prompt "Support OLED_SSD1306 Sample."
    default n
    depends on ENABLE_FARSIGHT_SAMPLE
    help
        This option means support OLED_SSD1306 Sample.

config SAMPLE_SUPPORT_RGB
    bool
    prompt "Support RGB Sample."
    default n
    depends on ENABLE_FARSIGHT_SAMPLE
    help
        This option means support RGB Sample.

config SAMPLE_SUPPORT_SHT20
    bool
    prompt "Support SHT20 Sample."
    default n
    depends on ENABLE_FARSIGHT_SAMPLE
    help
        This option means support SHT20 Sample.

config SAMPLE_SUPPORT_AP3216
    bool
    prompt "Support AP3216 Sample."
    default n
    depends on ENABLE_FARSIGHT_SAMPLE
    help
        This option means support AP3216 Sample.

config SAMPLE_SUPPORT_LCD
    bool
    prompt "Support LCD Sample."
    default n
    depends on ENABLE_FARSIGHT_SAMPLE
    help
        This option means support LCD Sample.

config SAMPLE_SUPPORT_WIFI_01_STA
    bool
    prompt "Support WIFI_01_STA Sample."
    default n
    depends on ENABLE_FARSIGHT_SAMPLE
    help
        This option means support WIFI_01_STA Sample.

config SAMPLE_SUPPORT_WIFI_02_AP
    bool
    prompt "Support WIFI_02_AP Sample."
    default n
    depends on ENABLE_FARSIGHT_SAMPLE
    help
        This option means support WIFI_02_AP Sample.

config SAMPLE_SUPPORT_WIFI_03_UDP
    bool
    prompt "Support WIFI_03_UDP Sample."
    default n
    depends on ENABLE_FARSIGHT_SAMPLE
    help
        This option means support WIFI_03_UDP Sample.

config SAMPLE_SUPPORT_WIFI_04_TCP
    bool
    prompt "Support WIFI_04_TCP Sample."
    default n
    depends on ENABLE_FARSIGHT_SAMPLE
    help
        This option means support WIFI_04_TCP Sample.

config SAMPLE_SUPPORT_WIFI_05_MQTT
    bool
    prompt "Support WIFI_05_MQTT Sample."
    default n
    depends on ENABLE_FARSIGHT_SAMPLE
    help
        This option means support WIFI_05_MQTT Sample.

config SAMPLE_SUPPORT_WIFI_06_HUAWEI_IOT
    bool
    prompt "Support WIFI_06_HUAWEI_IOT Sample."
    default n
    depends on ENABLE_FARSIGHT_SAMPLE
    help
        This option means support WIFI_06_HUAWEI_IOT Sample.

config SAMPLE_SUPPORT_BLE_TRANS_CLIENT
    bool
    prompt "Support BLE_TRANS_CLIENT Sample."
    default n
    depends on ENABLE_FARSIGHT_SAMPLE
    help
        This option means support BLE_TRANS_CLIENT Sample.

config SAMPLE_SUPPORT_BLE_TRANS_SERVER
    bool
    prompt "Support BLE_TRANS_SERVER Sample."
    default n
    depends on ENABLE_FARSIGHT_SAMPLE
    help
        This option means support BLE_TRANS_SERVER Sample.

config SAMPLE_SUPPORT_SLE_TRANS_SERVER
    bool
    prompt "Support SLE_TRANS_SERVER Sample."
    default n
    depends on ENABLE_FARSIGHT_SAMPLE
    help
        This option means support SLE_TRANS_SERVER Sample.

config SAMPLE_SUPPORT_SLE_TRANS_CLIENT
    bool
    prompt "Support SLE_TRANS_CLIENT Sample."
    default n
    depends on ENABLE_FARSIGHT_SAMPLE
    help
        This option means support SLE_TRANS_CLIENT Sample.
```
