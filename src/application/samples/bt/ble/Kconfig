## vendor/MYF_F63/peripheral/Kconfig
```kconfig
#===============================================================================
# @brief    Kconfig file.
# Copyright (c) HiSilicon (Shanghai) Technologies Co., Ltd. 2023-2023. All rights reserved.
#===============================================================================
config ENABLE_ALL_PERIPHERAL_SAMPLE
    bool
    prompt "Enable all the sample of peripheral, it's just for build."
    default n
    depends on ENABLE_PERIPHERAL_SAMPLE
    select SAMPLE_SUPPORT_BLINKY
    select SAMPLE_SUPPORT_BUTTON
    select SAMPLE_SUPPORT_DMA
    select SAMPLE_SUPPORT_PWM
    select SAMPLE_SUPPORT_TIMER
    select SAMPLE_SUPPORT_UART
    select SAMPLE_SUPPORT_WDT
    help
        This option means enable all the sample of peripheral, it is just for build.


config SAMPLE_SUPPORT_BLINKY
    bool
    prompt "Support BLINKY Sample."
    default n
    depends on ENABLE_PERIPHERAL_SAMPLE
    help
        This option means support BLINKY Sample.
if SAMPLE_SUPPORT_BLINKY
menu "Blinky Sample Configuration"
    osource "application/samples/peripheral/blinky/Kconfig"
endmenu
endif

config SAMPLE_SUPPORT_BUTTON
    bool
    prompt "Support BUTTON Sample."
    default n
    depends on ENABLE_PERIPHERAL_SAMPLE
    help
        This option means support BUTTON Sample.
if SAMPLE_SUPPORT_BUTTON
menu "BUTTON Sample Configuration"
    osource "application/samples/peripheral/button/Kconfig"
endmenu
endif

config SAMPLE_SUPPORT_DMA
    bool
    prompt "Support DMA Sample."
    default n
    depends on ENABLE_PERIPHERAL_SAMPLE
    help
        This option means support DMA Sample.
if SAMPLE_SUPPORT_DMA
menu "DMA Sample Configuration"
    osource "application/samples/peripheral/dma/Kconfig"
endmenu
endif

config SAMPLE_SUPPORT_PWM
    bool
    prompt "Support PWM Sample."
    default n
    depends on ENABLE_PERIPHERAL_SAMPLE
    help
        This option means support PWM Sample.
if SAMPLE_SUPPORT_PWM
menu "PWM Sample Configuration"
    osource "application/samples/peripheral/pwm/Kconfig"
endmenu
endif

config SAMPLE_SUPPORT_SYSTICK
    bool
    prompt "Support SYSTICK Sample."
    default n
    depends on ENABLE_PERIPHERAL_SAMPLE
    help
        This option means support SYSTICK Sample.
if SAMPLE_SUPPORT_SYSTICK
menu "SYSTICK Sample Configuration"
    osource "application/samples/peripheral/systick/Kconfig"
endmenu
endif

config SAMPLE_SUPPORT_TIMER
    bool
    prompt "Support TIMER Sample."
    default n
    depends on ENABLE_PERIPHERAL_SAMPLE
    help
        This option means support TIMER Sample.
if SAMPLE_SUPPORT_TIMER
menu "TIMER Sample Configuration"
    osource "application/samples/peripheral/timer/Kconfig"
endmenu
endif

config SAMPLE_SUPPORT_UART
    bool
    prompt "Support UART Sample."
    default n
    depends on ENABLE_PERIPHERAL_SAMPLE
    help
        This option means support UART Sample.
if SAMPLE_SUPPORT_UART
menu "UART Sample Configuration"
    osource "application/samples/peripheral/uart/Kconfig"
endmenu
endif

config SAMPLE_SUPPORT_WDT
    bool
    prompt "Support WATCHDOG Sample."
    default n
    depends on ENABLE_PERIPHERAL_SAMPLE
    help
        This option means support WATCHDOG Sample.
if SAMPLE_SUPPORT_WDT
menu "WATCHDOG Sample Configuration"
    osource "application/samples/peripheral/watchdog/Kconfig"
endmenu
endif
```

## vendor/MYF_F63/products/Kconfig
```kconfig
#===============================================================================
# @brief    Kconfig file.
# Copyright (c) @CompanyNameMagicTag 2023-2023. All rights reserved.
#===============================================================================
config ENABLE_ALL_PRODUCTS_SAMPLE
    bool
    prompt "Enable all the sample of product, it's just for build."
    default n
    depends on ENABLE_PRODUCTS_SAMPLE
    select SAMPLE_SUPPORT_AT_TEST

    help
        This option means enable all the sample of product, it is just for build.


config SAMPLE_SUPPORT_AT_TEST
    bool
    prompt "Support AT TEST sample."
    default n
    depends on ENABLE_PRODUCTS_SAMPLE
    help
        This option means support AT TEST Sample.

if SAMPLE_SUPPORT_AT_TEST
menu "AT_TEST Sample Configuration"
    osource "application/samples/products/at_test/Kconfig"
endmenu
endif
```

## vendor/developers/demo/sle_gate/Kconfig
```kconfig
config SAMPLE_SUPPORT_SLE_SERVER_ADC
    bool
    prompt "Support SLE_SERVER_ADC Sample."
    default n
    depends on SAMPLE_SUPPORT_SLE_GATE
    help
        This option means support SLE_SERVER_ADC Sample.

config SAMPLE_SUPPORT_SLE_SERVER_SERIAL
    bool
    prompt "Support SLE_SERVER_SERIAL Sample."
    default n
    depends on SAMPLE_SUPPORT_SLE_GATE
    help
        This option means support SLE_SERVER_SERIAL Sample.

config SAMPLE_SUPPORT_SLE_SERVER_LED
    bool
    prompt "Support SLE_SERVER_LED Sample."
    default n
    depends on SAMPLE_SUPPORT_SLE_GATE
    help
        This option means support SLE_SERVER_LED Sample.

config SAMPLE_SUPPORT_SLE_CLIENT
    bool
    prompt "Support SLE_CLIENT Sample."
    default n
    depends on SAMPLE_SUPPORT_SLE_GATE
    help
        This option means support SLE_CLIENT Sample.
```
